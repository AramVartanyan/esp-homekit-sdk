## examples/dehumidifier/main/Kconfig.projbuild
```kconfig
menu "HAP Settings"

    config USE_HARDCODED_SETUP_CODE
        bool "Use hard-coded setup code"
        default n
        help
            HomeKit does not recommend having the setup code programmed in the accessory as is.
            Instead, it expects setup info (salt-verifier pair) generated for the given setup code.
            Use this option only for testing purposes. For production, the setup info should be
            used.
            
    config SETUP_CODE
        string "HomeKit Setup Code"
        default "320-10-000"
        depends on USE_HARDCODED_SETUP_CODE
        help
            Setup code to be used for HomeKit pairing, if hard-coded setup code is enabled.

    config SETUP_ID
        string "HomeKit Setup Id"
        default "ES32"
        depends on USE_HARDCODED_SETUP_CODE
        help
            Setup id to be used for HomeKit pairing, if hard-coded setup code is enabled.

    config MANIFACTURER
        string "Device Manifacturer"
        default "Armo Ltd."
        help
            Insert the name of the Device Manifacturer.
            
    config NAME
        string "Device Name"
        default "Dehum-%02X%02X%02X"
        help
            Insert the name of the Device.

    config MODEL
        string "Device Model"
        default "HKBG Dehumidifier"
        help
            Insert the name of the Device Model.
            
    config HW
        string "Device Hardware"
        default "0.1.1"
        help
            Insert the revision of the Device Hardware.
            
    config RESET_GPIO
        int "Reset Button GPIO number"
        range 0 39
        default 17
        help
            GPIO number for Button Input.
            Some GPIOs are used for other purposes and cannot be used.

    config LOCAL_ON_GPIO
        int "Local On trigger GPIO number"
        range 0 39
        default 21
        help
            GPIO number for Button Input.
            Some GPIOs are used for other purposes and cannot be used.

    config LVL_SWITCH_GPIO
        int "Water Level Switch GPIO number"
        range 0 39
        default 22
        help
            GPIO number for Button Input.
            Some GPIOs are used for other purposes and cannot be used.

    config LED_GPIO
        int "LED GPIO number"
        range 0 34
        default 2
        help
            GPIO number for WiFi LED indicator.
            Some GPIOs are used for other purposes and cannot be used.
            GPIOs 35-39 are input-only so cannot be used as outputs.
            
    config RELAY_GPIO
        int "Relay GPIO number"
        range 0 34
        default 25
        help
            GPIO number for Channel 1 Relay output.
            Some GPIOs are used for other purposes and cannot be used.
            GPIOs 35-39 are input-only so cannot be used as outputs.

endmenu
```

## examples/dehumidifier/sdkconfig.defaults
```kconfig
CONFIG_IDF_TARGET="esp32"

CONFIG_APP_PROJECT_VER_FROM_CONFIG=y
CONFIG_APP_PROJECT_VER="0.0.3"

CONFIG_FIRMWARE_UPGRADE_URL="https://raw.githubusercontent.com/AramVartanyan/otafw/master/dehum.bin"
CONFIG_SKIP_COMMON_NAME_CHECK=y

CONFIG_PARTITION_TABLE_CUSTOM=y
CONFIG_PARTITION_TABLE_CUSTOM_FILENAME="partitions_hap.csv"
CONFIG_PARTITION_TABLE_OFFSET=0x8000
CONFIG_FREERTOS_UNICORE=y
CONFIG_FREERTOS_ASSERT_ON_UNTESTED_FUNCTION=n
CONFIG_FREERTOS_ASSERT_FAIL_ABORT=n
CONFIG_FREERTOS_ASSERT_DISABLE=y

CONFIG_LWIP_MAX_SOCKETS=16
CONFIG_LWIP_SO_REUSE=y
CONFIG_LWIP_MAX_ACTIVE_TCP=12
CONFIG_LWIP_MAX_LISTENING_TCP=12
CONFIG_LWIP_UDP_RECVMBOX_SIZE=10
CONFIG_MBEDTLS_HARDWARE_MPI=y
CONFIG_MBEDTLS_HARDWARE_SHA=n

CONFIG_ESP_TASK_WDT=n
CONFIG_LWIP_LOCAL_HOSTNAME="Dehumidifier"
CONFIG_LWIP_AUTOIP=y
CONFIG_LWIP_AUTOIP_RATE_LIMIT_INTERVAL=60
CONFIG_MP_BLOB_SUPPORT=y

CONFIG_ESPTOOLPY_FLASHSIZE_4MB=y
CONFIG_ESPTOOLPY_FLASHMODE_QIO=y

CONFIG_APP_WIFI_USE_PROVISIONING=y
CONFIG_APP_WIFI_CRED_SOURCE=1
CONFIG_APP_WIFI_USE_UNIFIED_PROVISIONING=y
CONFIG_APP_WIFI_PROVISIONING_TYPE=1
CONFIG_APP_WIFI_PROV_TRANSPORT_SOFTAP=y
CONFIG_APP_WIFI_PROV_TRANSPORT=1

CONFIG_ESP_DEFAULT_CPU_FREQ_MHZ_240=y
CONFIG_ESP_DEFAULT_CPU_FREQ_MHZ=240

CONFIG_COMPILER_OPTIMIZATION_PERF=y

CONFIG_ESP_SHA=y
CONFIG_LIBSODIUM_USE_MBEDTLS_SHA=y
CONFIG_MBEDTLS_DEFAULT_MEM_ALLOC=y
CONFIG_MBEDTLS_ASYMMETRIC_CONTENT_LEN=y

CONFIG_NEWLIB_LIBRARY_LEVEL_NORMAL=y

CONFIG_LOG_DEFAULT_LEVEL_WARN=y

CONFIG_AHT_SDA=19
CONFIG_AHT_SCL=18
# esp-homekit-sdk (esp_mfi_i2c.c) uses the legacy I2C driver: esp_aht must use it too
CONFIG_AHT_I2C_LEGACY=y
```

## examples/waterbatt/main/Kconfig.projbuild
```kconfig
menu "Device Settings"

    config USE_HARDCODED_SETUP_CODE
        bool "Use hard-coded setup code"
        default n
        help
            HomeKit does not recommend having the setup code programmed in the accessory as is.
            Instead, it expects setup info (salt-verifier pair) generated for the given setup code.
            Use this option only for testing purposes. For production, the setup info should be
            used.
            
    config SETUP_CODE
        string "HomeKit Setup Code"
        default "111-22-333"
        depends on USE_HARDCODED_SETUP_CODE
        help
            Setup code to be used for HomeKit pairing, if hard-coded setup code is enabled.

    config SETUP_ID
        string "HomeKit Setup Id"
        default "ES32"
        depends on USE_HARDCODED_SETUP_CODE
        help
            Setup id to be used for HomeKit pairing, if hard-coded setup code is enabled.

    config MANIFACTURER
        string "Device Manifacturer"
        default "Armo Ltd."
        help
            Insert the name of the Device Manifacturer.
       
    config NAME
        string "Device Name"
        default "WaterBat-%02X%02X%02X"
        help
            Insert the name of the Device.

    config MODEL
        string "Device Model"
        default "Valve on Solar"
        help
            Insert the name of the Device Model.
            
    config HW
        string "Device Hardware"
        default "0.1.3"
        help
            Insert the revision of the Device Hardware.
            
    config BUTTON_GPIO
        int "Reset Button GPIO number"
        range 0 46
        default 0
        help
            GPIO number for Reset Button.
            Some GPIOs are used for other purposes and cannot be used.
            
    config CHARGE_GPIO
        int "Charging status GPIO number"
        range 0 46
        default 7
        help
            GPIO number for Charging status.
            Some GPIOs are used for other purposes and cannot be used.

    config LED_GPIO
        int "LED GPIO number"
        range 0 46
        default 15
        help
            GPIO number for LED output.
            Some GPIOs are used for other purposes and cannot be used.
            
    config RELAY_GPIO
        int "Relay GPIO number"
        range 0 46
        default 35
        help
            GPIO number for Relay output.
            Some GPIOs are used for other purposes and cannot be used.

    config ADC_UNIT
        int "ADC Unit selection"
        range 0 1
        default 0
        help
            0 = ADC_UNIT_1
            1 = ADC_UNIT_2
            Note: On ESP32C3, ADC2 is no longer supported, due to its HW limitation.

    config ADC_CHANNEL
        int "ADC Channel"
        range 0 9
        default 3
        help
            0 = ADC_CHANNEL_0
            1 = ADC_CHANNEL_1
            ...
            9 = ADC_CHANNEL_9
            ESP32 -> ADC1 8 channels: GPIO32 - GPIO39 and
            ADC2 10 channels: GPIO0, GPIO2, GPIO4, GPIO12 - GPIO15, GOIO25 - GPIO27
            ESP32-S2 -> ADC1 10 channels: GPIO1 - GPIO10 and ADC2 10 channels: GPIO11 - GPIO20
            ESP32-S2 -> ADC1 10 channels: GPIO1 - GPIO10 and ADC2 10 channels: GPIO11 - GPIO20
            ESP32-C3 -> 5 channels: GPIO0 - GPIO4
            

    config ADC_ATTENUATION
        int "ADC Attenuation level"
        range 0 3
        default 1
        help
            0 = ADC_ATTEN_DB_0 No input attenuation Max 0,75V/0,95V
            1 = ADC_ATTEN_DB_2_5 The input voltage of ADC will be attenuated extending the range of measurement by about 2.5 dB (1.33 x)
            2 = ADC_ATTEN_DB_6 The input voltage of ADC will be attenuated extending the range of measurement by about 6 dB (2 x)
            3 = ADC_ATTEN_DB_11 The input voltage of ADC will be attenuated extending the range of measurement by about 11 dB (3.55 x)

endmenu
```

## examples/waterbatt/sdkconfig.defaults
```kconfig
CONFIG_IDF_TARGET="esp32s2"

CONFIG_ESP_CONSOLE_USB_CDC=y

CONFIG_APP_PROJECT_VER_FROM_CONFIG=y
CONFIG_APP_PROJECT_VER="0.3.9"

CONFIG_FIRMWARE_UPGRADE_URL="https://raw.githubusercontent.com/AramVartanyan/otafw/master/wb23.bin"
CONFIG_SKIP_COMMON_NAME_CHECK=y

CONFIG_MBEDTLS_CERTIFICATE_BUNDLE_DEFAULT_CMN=y

CONFIG_PARTITION_TABLE_CUSTOM=y
CONFIG_PARTITION_TABLE_CUSTOM_FILENAME="partitions_hap.csv"
CONFIG_PARTITION_TABLE_CUSTOM_APP_BIN_OFFSET=0x8000
CONFIG_FREERTOS_UNICORE=y
CONFIG_FREERTOS_ASSERT_ON_UNTESTED_FUNCTION=n
CONFIG_FREERTOS_ASSERT_FAIL_ABORT=n
CONFIG_FREERTOS_ASSERT_DISABLE=y

CONFIG_LWIP_MAX_SOCKETS=16
CONFIG_LWIP_SO_REUSE=y
CONFIG_LWIP_MAX_ACTIVE_TCP=12
CONFIG_LWIP_MAX_LISTENING_TCP=12
CONFIG_LWIP_UDP_RECVMBOX_SIZE=10
CONFIG_MBEDTLS_HARDWARE_MPI=y
CONFIG_MBEDTLS_HARDWARE_SHA=n

CONFIG_ESP_TASK_WDT_INIT=n
CONFIG_LWIP_LOCAL_HOSTNAME="WB23"
CONFIG_LWIP_AUTOIP=y
CONFIG_LWIP_AUTOIP_RATE_LIMIT_INTERVAL=60
CONFIG_MP_BLOB_SUPPORT=y

CONFIG_ESPTOOLPY_FLASHSIZE_4MB=y
CONFIG_ESPTOOLPY_FLASHMODE_QIO=y

CONFIG_APP_WIFI_USE_PROVISIONING=y
CONFIG_APP_WIFI_CRED_SOURCE=1
CONFIG_APP_WIFI_USE_UNIFIED_PROVISIONING=y
CONFIG_APP_WIFI_PROVISIONING_TYPE=1
CONFIG_APP_WIFI_PROV_TRANSPORT_SOFTAP=y
CONFIG_APP_WIFI_PROV_TRANSPORT=1

CONFIG_ESP_DEFAULT_CPU_FREQ_MHZ_160=y
CONFIG_ESP_DEFAULT_CPU_FREQ_MHZ=160

CONFIG_COMPILER_OPTIMIZATION_PERF=y

CONFIG_AHT_SDA=33
CONFIG_AHT_SCL=18

CONFIG_ADC_UNIT=0
CONFIG_ADC_CHANNEL=2
CONFIG_ADC_ATTENUATION=1

# CONFIG_ESP_PHY_MAX_WIFI_TX_POWER=10
# CONFIG_ESP_PHY_RF_CAL_FULL=y
# CONFIG_ESP_PHY_CALIBRATION_MODE=2
```
